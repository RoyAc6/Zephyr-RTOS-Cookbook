## CMakeLists.txt
```
# SPDX-License-Identifier: Apache-2.0

cmake_minimum_required(VERSION 3.20.0)

find_package(Zephyr REQUIRED HINTS $ENV{ZEPHYR_BASE})
project(user_toto2)

target_sources(app PRIVATE src/main.c)
```

## prj.conf
```kconfig
CONFIG_USERSPACE=y

# Added automatically by Workbench for Zephyr
#--- DEBUG PRESET - BEGIN ---#
# Set to -Og
CONFIG_DEBUG_OPTIMIZATIONS=y
# Thread awareness support
CONFIG_DEBUG_THREAD_INFO=y
# Generate stack usage per-function
CONFIG_STACK_USAGE=y
# Other options in case not set by default
CONFIG_BUILD_OUTPUT_HEX=y
CONFIG_BUILD_OUTPUT_META=y
CONFIG_OUTPUT_SYMBOLS=y
CONFIG_OUTPUT_STAT=y
CONFIG_OUTPUT_DISASSEMBLY=y
CONFIG_OUTPUT_PRINT_MEMORY_USAGE=y
#--- DEBUG PRESET - END ---#
```

## src/main.c
```c
#include <zephyr/kernel.h>
#include <zephyr/app_memory/app_memdomain.h>
#include <zephyr/sys/libc-hooks.h>

K_APPMEM_PARTITION_DEFINE(part_a);
K_APPMEM_PARTITION_DEFINE(part_b);
K_APPMEM_PARTITION_DEFINE(part_shared);

K_APP_DMEM(part_a) int a_var = 11;
K_APP_DMEM(part_b) int b_var = 22;
K_APP_DMEM(part_shared) int s_var = 99;

static void app_a_thread(void *p1, void *p2, void *p3)
{
	printk("a=%d s=%d\n", a_var, s_var);

	printk("b=%d\n", b_var);

	while (1)
	{
		k_sleep(K_SECONDS(1));
	}
}

static struct k_mem_domain domain_a;

static struct k_mem_partition *domain_a_parts[] = {
#ifdef CONFIG_CPU_CORTEX_M
	&z_libc_partition,
#endif
	&part_a,
	&part_shared
};

K_THREAD_DEFINE(a_tid, 512, app_a_thread,
	NULL, NULL, NULL, 5, K_USER, 0);

int main(void)
{
	k_mem_domain_init(
		&domain_a,
		ARRAY_SIZE(domain_a_parts),
		domain_a_parts);

	k_mem_domain_add_thread(&domain_a, a_tid);
	
	return 0;
}
```
