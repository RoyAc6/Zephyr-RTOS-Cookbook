## CMakeLists.txt
```
# SPDX-License-Identifier: Apache-2.0

cmake_minimum_required(VERSION 3.20.0)

find_package(Zephyr REQUIRED HINTS $ENV{ZEPHYR_BASE})
project(myrandom3)

target_sources(app PRIVATE src/main.c)
```

## prj.conf
```kconfig
CONFIG_TEST_RANDOM_GENERATOR=y
CONFIG_LOG=y
CONFIG_LOG_DEFAULT_LEVEL=3
CONFIG_SHELL=y
CONFIG_SHELL_BACKEND_SERIAL=y

# Added automatically by Workbench for Zephyr
#--- DEBUG PRESET - BEGIN ---#
# Set to -Og
CONFIG_DEBUG_OPTIMIZATIONS=y
# Thread awareness support
CONFIG_DEBUG_THREAD_INFO=y
# Generate stack usage per-function
CONFIG_STACK_USAGE=y
# Other options in case not set by default
CONFIG_BUILD_OUTPUT_HEX=y
CONFIG_BUILD_OUTPUT_META=y
CONFIG_OUTPUT_SYMBOLS=y
CONFIG_OUTPUT_STAT=y
CONFIG_OUTPUT_DISASSEMBLY=y
CONFIG_OUTPUT_PRINT_MEMORY_USAGE=y
#--- DEBUG PRESET - END ---#
```

## src/main.c
```c
#include <zephyr/kernel.h>
#include <zephyr/shell/shell.h>
#include <zephyr/random/random.h>

static int cmd_random_get(const struct shell *shell, size_t argc, char **argv)
{
	uint32_t value = sys_rand32_get();
	shell_print(shell, "Random value: %u", value);
	return 0;
}

static int cmd_random_help(const struct shell *shell, size_t argc, char **argv)
{
	shell_print(shell, "myrandom get : generate a random value");
	shell_print(shell, "myrandom help : show this message");
	return 0;
}

SHELL_STATIC_SUBCMD_SET_CREATE(sub_myrandom,
							   SHELL_CMD(get, NULL, "Generate a random value", cmd_random_get),
							   SHELL_CMD(help, NULL, "Show command help", cmd_random_help),
							   SHELL_SUBCMD_SET_END);

SHELL_CMD_REGISTER(myrandom, &sub_myrandom, "Random number commands", NULL);
```
