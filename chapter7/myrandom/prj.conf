## CMakeLists.txt
```
# SPDX-License-Identifier: Apache-2.0

cmake_minimum_required(VERSION 3.20.0)

find_package(Zephyr REQUIRED HINTS $ENV{ZEPHYR_BASE})
project(myrandom)

target_sources(app PRIVATE src/main.c)
```

## prj.conf
```kconfig
CONFIG_TEST_RANDOM_GENERATOR=y


# Added automatically by Workbench for Zephyr
#--- DEBUG PRESET - BEGIN ---#
# Set to -Og
CONFIG_DEBUG_OPTIMIZATIONS=y
# Thread awareness support
CONFIG_DEBUG_THREAD_INFO=y
# Generate stack usage per-function
CONFIG_STACK_USAGE=y
# Other options in case not set by default
CONFIG_BUILD_OUTPUT_HEX=y
CONFIG_BUILD_OUTPUT_META=y
CONFIG_OUTPUT_SYMBOLS=y
CONFIG_OUTPUT_STAT=y
CONFIG_OUTPUT_DISASSEMBLY=y
CONFIG_OUTPUT_PRINT_MEMORY_USAGE=y
#--- DEBUG PRESET - END ---#
```

## src/main.c
```c
#include <zephyr/kernel.h>
#include <zephyr/random/random.h>

int main(void)
{
	while (1)
	{
		uint32_t value = sys_rand32_get();
		printk("Random value: %u\n", value);
		k_sleep(K_MSEC(1000));
	}
	return 0;
}
```
