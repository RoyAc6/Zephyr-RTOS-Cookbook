## chapter3/kconfig_toto/Kconfig
```kconfig
mainmenu "My ToTo App Configuration"

source "Kconfig.zephyr"

menu "ToTo Application Options"
    config TOTO
    bool "Enable ToTo feature"
    default n
    help
        Enables the toto dummy feature in this application.
endmenu
```

## chapter5/mytotoled/dts/bindings/toto-led.yaml
```yaml
compatible: toto-led

description: Example custom node describing a single LED GPIO and a blink delay.

properties:
  toto-gpios:
    type: phandle-array
    required: true
    description: My LED GPIO.
  my-delay-ms:
    type: int
    required: false
    default: 500
    description: Blink delay in milliseconds.
```

## west.yml
```yaml
manifest:
  remotes:
    - name: zephyrproject
      url-base: https://github.com/zephyrproject-rtos
  projects:
    - name: zephyr
      repo-path: zephyr
      remote: zephyrproject
      revision: v4.4.1
      import:
        path-prefix: deps
        name-allowlist:
          - cmsis_6
          - percepio
          - hal_stm32
          - hal_nxp
```
