&adc1 {
	pinctrl-0 = <&adc1_inp3_pa6>;
	status = "okay";
	st,adc-prescaler = <4>;
	channel@3 {
		reg = <3>;
		zephyr,gain = "ADC_GAIN_1";
		zephyr,reference = "ADC_REF_INTERNAL";
		zephyr,acquisition-time = <ADC_ACQ_TIME_DEFAULT>;
		zephyr,resolution = <12>;
	};
};

/ {
	aliases {
		myadc = &adc1;
	};
};
